// Copyright (C) 2025-2026 356C LLC
// SPDX-License-Identifier: GPL-3.0-or-later

/**
 * @file test_gcode_layer_index_line_framing.cpp
 * @brief Pins GCodeLayerIndex's line framing across the block-buffered read.
 *
 * The scan was rewritten from std::getline on a default-buffered ifstream to a
 * 1MB block reader: getline walked the file a character at a time through the
 * streambuf, and on a 133MB / 5M-line print that dispatch dominated the 69s
 * index build measured on a K2 Plus.
 *
 * The entries this scan emits are FILE OFFSETS the renderer seeks to, and the
 * offset is advanced by (line length + 1) per line. So the replacement has to
 * frame lines exactly as getline did or every layer's byte range shifts — a
 * failure that corrupts the render silently instead of erroring. The cases that
 * can drift: a file that does not end in a newline, CRLF (the file is opened
 * binary, so the '\r' belongs to the line), empty lines, and a line that
 * straddles a block boundary.
 *
 * These drive the public build_from_file() and assert on total_lines, which is
 * incremented once per framed line — the same counter the offset arithmetic
 * rides on.
 */

#include "gcode_layer_index.h"

#include <algorithm>
#include <cstdio>
#include <filesystem>
#include <fstream>
#include <string>
#include <unistd.h>
#include <vector>

#include "../catch_amalgamated.hpp"

using helix::gcode::GCodeLayerIndex;

namespace {

/// Writes bytes verbatim (binary — no newline translation) and cleans up.
struct TempGcode {
    std::filesystem::path path;
    explicit TempGcode(const std::string& bytes, const std::string& tag) {
        path = std::filesystem::temp_directory_path() /
               ("helix_lineframe_" + tag + "_" + std::to_string(::getpid()) + ".gcode");
        std::ofstream f(path, std::ios::binary | std::ios::trunc);
        f.write(bytes.data(), static_cast<std::streamsize>(bytes.size()));
    }
    ~TempGcode() {
        std::error_code ec;
        std::filesystem::remove(path, ec);
    }
};

/// A minimal body the indexer accepts: marker-based layers with Z moves, so
/// build_from_file() returns true (it reports false when no layer was found).
std::string layered_body() {
    std::string out = "; generated by test\n";
    for (int i = 0; i < 3; ++i) {
        out += ";LAYER_CHANGE\n";
        out += "G1 Z" + std::to_string(i + 1) + ".0 F600\n";
        out += "G1 X10 Y10 E1.5\n";
    }
    return out;
}

} // namespace

TEST_CASE("layer index: a file with no trailing newline still frames its last line",
          "[gcode][layer_index][framing]") {
    // getline yields the trailing fragment; the block reader must too, or the
    // final layer's line_count is short by one.
    const std::string body = layered_body() + "G1 X20 Y20 E2.5"; // <- no '\n'
    TempGcode f(body, "notrail");

    GCodeLayerIndex index;
    REQUIRE(index.build_from_file(f.path.string()));
    // 1 header + 3*(marker + Z + move) + 1 trailing fragment
    CHECK(index.get_stats().total_lines == 11);
}

TEST_CASE("layer index: a file ending in a newline yields no phantom final line",
          "[gcode][layer_index][framing]") {
    const std::string body = layered_body(); // ends with '\n'
    TempGcode f(body, "trail");

    GCodeLayerIndex index;
    REQUIRE(index.build_from_file(f.path.string()));
    CHECK(index.get_stats().total_lines == 10);
}

TEST_CASE("layer index: empty lines are framed, not swallowed", "[gcode][layer_index][framing]") {
    // An empty line still occupies a byte in the file and getline returns it,
    // so the offset arithmetic counts it. Dropping it would shift every layer
    // after the blank.
    const std::string body = layered_body() + "\n\n\n";
    TempGcode f(body, "blanks");

    GCodeLayerIndex index;
    REQUIRE(index.build_from_file(f.path.string()));
    CHECK(index.get_stats().total_lines == 13);
}

TEST_CASE("layer index: CRLF keeps the carriage return on the line",
          "[gcode][layer_index][framing]") {
    // The file is opened binary, so getline stripped only the '\n' and left the
    // '\r' in the line — which is what makes length + 1 the right advance. A
    // reader that also ate the '\r' would under-count every offset by one byte
    // per line.
    std::string body;
    for (char c : layered_body()) {
        if (c == '\n') {
            body += '\r';
        }
        body += c;
    }
    TempGcode f(body, "crlf");

    GCodeLayerIndex index;
    REQUIRE(index.build_from_file(f.path.string()));
    CHECK(index.get_stats().total_lines == 10);
    CHECK(index.get_stats().total_bytes == body.size());
}

TEST_CASE("layer index: a line straddling the read block is not split",
          "[gcode][layer_index][framing]") {
    // The reader pulls 1MB at a time. A line that begins before a block edge
    // and ends after it must come out whole — split in two, it would both
    // double-count lines and mis-tag a movement command as two fragments.
    // Padding a comment to push a real command across the 1MB boundary is the
    // cheapest way to land on it deterministically.
    const size_t block = 1024 * 1024;
    std::string body = "; header\n";
    const std::string filler = "; " + std::string(200, 'x') + "\n";
    while (body.size() + filler.size() < block - 20) {
        body += filler;
    }
    const size_t lines_before = static_cast<size_t>(std::count(body.begin(), body.end(), '\n'));
    // This comment starts just under the boundary and finishes past it.
    body += "; " + std::string(120, 'y') + "\n";
    body += layered_body();

    TempGcode f(body, "straddle");
    GCodeLayerIndex index;
    REQUIRE(index.build_from_file(f.path.string()));
    CHECK(index.get_stats().total_lines == lines_before + 1 + 10);
}

TEST_CASE("layer index: progress is reported and ends at the whole file",
          "[gcode][layer_index][framing][progress]") {
    // get_index_progress() used to go 0.0 -> 1.0 with nothing between, so the
    // only honest UI was an indeterminate spinner. The callback is coarse (every
    // N lines), so a small file may report nothing at all — what must hold is
    // that anything it DOES report is a sane fraction.
    std::string body = "; header\n";
    for (int i = 0; i < 60000; ++i) {
        body += "G1 X" + std::to_string(i % 100) + " Y10 E0.1\n";
    }
    body += layered_body();
    TempGcode f(body, "progress");

    std::vector<float> seen;
    GCodeLayerIndex index;
    REQUIRE(index.build_from_file(f.path.string(), [&](float p) { seen.push_back(p); }));

    REQUIRE_FALSE(seen.empty());
    for (float p : seen) {
        CHECK(p >= 0.0f);
        CHECK(p <= 1.0f);
    }
    // Monotonic: the scan only moves forward through the file.
    for (size_t i = 1; i < seen.size(); ++i) {
        CHECK(seen[i] >= seen[i - 1]);
    }
}

// ============================================================================
// Axis value parsing must agree with strtof
// ============================================================================
//
// The index scan replaced std::strtof with a fast decimal path for the plain
// forms slicers emit. That was not a guess: a micro-benchmark on a K2 Plus put
// the scanning around the number at 1.82us/line and the same scan WITH strtof
// at 22.06us/line — musl's strtof is 92% of the work, and over a 5M-line print
// it is the bulk of a 63-second index build.
//
// The fast path is only safe if it agrees with strtof, so these drive real
// coordinates through the public index and compare the recovered bounds
// against values computed independently. Forms the fast path deliberately
// refuses (exponents, overlong mantissas) must still parse — it falls back.

TEST_CASE("layer index: axis values agree with strtof across realistic forms",
          "[gcode][layer_index][framing][parse]") {
    // Bounds are accumulated from X/Y on extruding moves, so a file whose
    // extremes are known pins the parse: if any coordinate were mis-parsed the
    // min/max would move.
    std::string body = "; test\nM82\n;LAYER_CHANGE\nG1 Z0.30 F600\n;TYPE:External perimeter\n";
    double e = 0.0;
    struct Case {
        const char* x;
        const char* y;
    };
    const Case cases[] = {
        {"5.3", "5.3"},               // plain
        {"344.8", "344.8"},           // plain, larger
        {"100", "200"},               // no fraction at all
        {".5", ".25"},                // leading dot (OrcaSlicer emits E.05482)
        {"+12.5", "+13.5"},           // explicit plus
        {"170.123456", "170.654321"}, // six fractional digits
        {"1e2", "2e1"},               // scientific — fast path refuses, strtof runs
    };
    for (const auto& c : cases) {
        e += 1.5;
        body += std::string("G1 X") + c.x + " Y" + c.y + " E" + std::to_string(e) + "\n";
    }
    // A trailing comment containing axis letters must not be read as data.
    e += 1.5;
    body += "G1 X50 Y50 E" + std::to_string(e) + " ; X999 Y999 travel\n";

    TempGcode f(body, "parse");
    GCodeLayerIndex index;
    REQUIRE(index.build_from_file(f.path.string()));
    const auto& st = index.get_stats();

    REQUIRE(st.has_xy_bounds());
    // Min across the set is 0.25 (the ".25" Y); max is 344.8. If the comment
    // were parsed, max would be 999.
    CHECK(st.min_x == Catch::Approx(0.5f).margin(0.001));
    CHECK(st.max_x == Catch::Approx(344.8f).margin(0.001));
    CHECK(st.min_y == Catch::Approx(0.25f).margin(0.001));
    CHECK(st.max_y == Catch::Approx(344.8f).margin(0.001));
}

TEST_CASE("layer index: negative and high-precision coordinates round-trip",
          "[gcode][layer_index][framing][parse]") {
    // Negative coordinates are legal (bed origin offsets) and the fast path
    // handles the sign itself; a long mantissa is where it bails to strtof.
    std::string body = "; test\nM82\n;LAYER_CHANGE\nG1 Z0.30 F600\n;TYPE:External perimeter\n";
    body += "G1 X-12.75 Y-3.5 E1.5\n";
    body += "G1 X123.4567890123456789 Y99.9 E3.0\n"; // overlong -> strtof
    TempGcode f(body, "parse_neg");

    GCodeLayerIndex index;
    REQUIRE(index.build_from_file(f.path.string()));
    const auto& st = index.get_stats();

    REQUIRE(st.has_xy_bounds());
    CHECK(st.min_x == Catch::Approx(-12.75f).margin(0.001));
    CHECK(st.max_x == Catch::Approx(123.456789f).margin(0.001));
    CHECK(st.min_y == Catch::Approx(-3.5f).margin(0.001));
    CHECK(st.max_y == Catch::Approx(99.9f).margin(0.001));
}
