// Copyright (C) 2025-2026 356C LLC
// SPDX-License-Identifier: GPL-3.0-or-later
//
// Regression tests for prestonbrown/helixscreen#1127.
//
// Streaming mode re-parses each layer's byte range with a fresh GCodeParser.
// M82/M83 sit once in the file prologue, outside every layer range, so the
// fresh parser assumed absolute E and read relative deltas as absolute
// positions — its computed delta was then the difference *between consecutive
// deltas*. Spiral-vase G-code repeats one E value for the entire spiral, making
// that difference exactly zero and classifying the whole model as travel.
//
// The fixtures below are generated rather than checked in: they reproduce the
// exact shape of OrcaSlicer output (M83 prologue, ;LAYER_CHANGE markers, Z on
// every move, leading-dot E values) at a few KB instead of hundreds.

#include "gcode_layer_index.h"
#include "gcode_parser.h"
#include "gcode_projection.h"
#include "gcode_streaming_controller.h"

#include <cmath>
#include <cstdio>
#include <fstream>
#include <sstream>
#include <string>
#include <unistd.h>

#include "../catch_amalgamated.hpp"

using namespace helix::gcode;
using Catch::Approx;

namespace {

class TempGCodeFile {
  public:
    TempGCodeFile(const std::string& tag, const std::string& content) {
        path_ = "/tmp/test_vase_1127_" + tag + "_" + std::to_string(::getpid()) + ".gcode";
        std::ofstream f(path_);
        f << content;
    }
    ~TempGCodeFile() {
        std::remove(path_.c_str());
    }
    const std::string& path() const {
        return path_;
    }

  private:
    std::string path_;
};

// Orca-style prologue. M83 is the load-bearing line: it is emitted exactly once,
// before every layer's byte range.
const char* PROLOGUE = R"(; generated by test
M190 S60
M104 S210
G90
M83 ; use relative distances for extrusion
G28
G1 Z0.2 F1000
;TYPE:Custom
G1 X2 Y2 Z0.2 E5.0 F1200
)";

// Square ring of `side` mm centred on (110,110), emitted as `steps` equal moves.
// Equal-length moves mean an identical E value on every line — exactly what a
// spiral emits, and the input that collapsed to a zero delta.
void emit_ring(std::string& out, float z_start, float z_step_per_move, float half, int steps,
               bool z_on_every_move) {
    const float cx = 110.0f, cy = 110.0f;
    char buf[160];
    float z = z_start;
    for (int i = 0; i < steps; ++i) {
        // Walk the perimeter of the square.
        float t = 4.0f * static_cast<float>(i) / static_cast<float>(steps);
        float x, y;
        if (t < 1.0f) {
            x = cx - half + 2 * half * t;
            y = cy - half;
        } else if (t < 2.0f) {
            x = cx + half;
            y = cy - half + 2 * half * (t - 1.0f);
        } else if (t < 3.0f) {
            x = cx + half - 2 * half * (t - 2.0f);
            y = cy + half;
        } else {
            x = cx - half;
            y = cy + half - 2 * half * (t - 3.0f);
        }
        z += z_step_per_move;
        if (z_on_every_move) {
            // Leading-dot E, constant per move — the Orca spiral-vase form.
            snprintf(buf, sizeof(buf), "G1 Z%.3f X%.3f Y%.3f E.07628\n", z, x, y);
        } else {
            snprintf(buf, sizeof(buf), "G1 X%.3f Y%.3f E.07628\n", x, y);
        }
        out += buf;
    }
}

std::string make_vase_gcode(int layers, int steps_per_layer) {
    std::string g = PROLOGUE;
    const float layer_h = 0.2f;
    float z = 0.2f;
    for (int l = 0; l < layers; ++l) {
        g += ";LAYER_CHANGE\n";
        char buf[64];
        snprintf(buf, sizeof(buf), ";Z:%.3f\n", z + layer_h);
        g += buf;
        if (l == 0) {
            g += ";TYPE:Outer wall\n";
        }
        // Z rises continuously across the layer — the defining property of vase mode.
        emit_ring(g, z, layer_h / static_cast<float>(steps_per_layer), 24.5f, steps_per_layer,
                  true);
        z += layer_h;
    }
    return g;
}

// Same geometry and same relative-E convention, but discrete layers: Z only
// changes at the layer boundary. This is the control — it must stay correct.
std::string make_normal_gcode(int layers, int steps_per_layer) {
    std::string g = PROLOGUE;
    const float layer_h = 0.2f;
    float z = 0.2f;
    for (int l = 0; l < layers; ++l) {
        z += layer_h;
        g += ";LAYER_CHANGE\n";
        char buf[64];
        snprintf(buf, sizeof(buf), ";Z:%.3f\n", z);
        g += buf;
        snprintf(buf, sizeof(buf), "G1 Z%.3f F24000\n", z);
        g += buf;
        if (l == 0) {
            g += ";TYPE:Outer wall\n";
        }
        emit_ring(g, z, 0.0f, 24.5f, steps_per_layer, false);
    }
    return g;
}

// Count extrusion segments the streaming path produces for one layer.
struct LayerProbe {
    size_t total = 0;
    size_t extrusion = 0;
};

LayerProbe probe_layer(GCodeStreamingController& ctl, size_t layer) {
    LayerProbe p;
    auto segs = ctl.get_layer_segments(layer);
    if (!segs) {
        return p;
    }
    p.total = segs->size();
    for (const auto& s : *segs) {
        if (s.is_extrusion) {
            p.extrusion++;
        }
    }
    return p;
}

} // namespace

TEST_CASE("#1127 spiral-vase: streaming layers keep their extrusion flags",
          "[gcode][streaming][vase1127]") {
    constexpr int LAYERS = 40;
    constexpr int STEPS = 64;
    TempGCodeFile vase("vase", make_vase_gcode(LAYERS, STEPS));

    GCodeStreamingController ctl;
    REQUIRE(ctl.open_file(vase.path()));
    REQUIRE(ctl.get_layer_count() >= static_cast<size_t>(LAYERS));

    // Middle layer: pure spiral wall, every move extrudes. Before the fix this
    // reported a handful of extrusions out of 64 because each E delta was zero.
    LayerProbe mid = probe_layer(ctl, ctl.get_layer_count() / 2);
    INFO("mid layer: " << mid.extrusion << "/" << mid.total << " flagged as extrusion");
    REQUIRE(mid.total >= static_cast<size_t>(STEPS));
    // Allow the single leading move into the layer to be non-extruding.
    CHECK(mid.extrusion >= mid.total - 1);
}

TEST_CASE("#1127 spiral-vase: index XY bounds match the full-file parser",
          "[gcode][streaming][vase1127]") {
    constexpr int LAYERS = 40;
    constexpr int STEPS = 64;

    auto check_bounds = [](const std::string& path) {
        // Ground truth: the whole file through one parser.
        GCodeParser parser;
        std::ifstream f(path);
        std::string line;
        while (std::getline(f, line)) {
            parser.parse_line(line);
        }
        auto full = parser.finalize();
        REQUIRE_FALSE(full.global_bounding_box.is_empty());

        GCodeLayerIndex index;
        REQUIRE(index.build_from_file(path));
        const auto& st = index.get_stats();
        REQUIRE(st.has_xy_bounds());

        // The index accumulates over every extruding move, so it should agree
        // with the full parse to within float noise — not the "sample three
        // layers" estimate that framed vase prints against a 3-point hull.
        CHECK(st.min_x == Approx(full.global_bounding_box.min.x).margin(0.01));
        CHECK(st.max_x == Approx(full.global_bounding_box.max.x).margin(0.01));
        CHECK(st.min_y == Approx(full.global_bounding_box.min.y).margin(0.01));
        CHECK(st.max_y == Approx(full.global_bounding_box.max.y).margin(0.01));
    };

    SECTION("vase mode") {
        TempGCodeFile g("vase_bb", make_vase_gcode(LAYERS, STEPS));
        check_bounds(g.path());
    }
    SECTION("normal mode (control)") {
        TempGCodeFile g("norm_bb", make_normal_gcode(LAYERS, STEPS));
        check_bounds(g.path());
    }
}

TEST_CASE("#1127 index counts real extrusion moves, not 'E followed by a digit'",
          "[gcode][streaming][vase1127]") {
    // Every move in these fixtures uses OrcaSlicer's leading-dot form (E.07628).
    // The old text heuristic required a digit or '+' right after the E, so it
    // scored an entire Orca file as ~100% travel.
    TempGCodeFile g("estats", make_normal_gcode(20, 32));

    GCodeLayerIndex index;
    REQUIRE(index.build_from_file(g.path()));
    const auto& st = index.get_stats();
    INFO("extrusion=" << st.extrusion_moves << " travel=" << st.travel_moves);
    CHECK(st.extrusion_moves >= 20 * 32);
    // The only non-extruding moves are homing, the layer-change Z hops and the
    // purge line — nowhere near a majority.
    CHECK(st.travel_moves < st.extrusion_moves);
}

TEST_CASE("#1127 per-layer parse honours layer markers instead of splitting on Z",
          "[gcode][streaming][vase1127]") {
    // Vase G-code carries a Z on every move. Without marker seeding the fresh
    // per-layer parser fell back to "every Z change starts a layer" and built
    // one Layer object (and its segment vector) per move.
    TempGCodeFile g("markers", make_vase_gcode(10, 64));

    GCodeLayerIndex index;
    REQUIRE(index.build_from_file(g.path()));
    REQUIRE(index.uses_layer_markers());

    const StreamingLayerEntry entry = index.get_entry(index.get_layer_count() / 2);
    std::ifstream f(g.path(), std::ios::binary);
    std::string bytes(entry.byte_length, '\0');
    f.seekg(static_cast<std::streamoff>(entry.file_offset));
    f.read(&bytes[0], static_cast<std::streamsize>(entry.byte_length));

    GCodeParser parser;
    parser.set_initial_position(entry.start_x, entry.start_y, entry.start_z);
    parser.set_initial_feature_type(entry.start_feature_type);
    parser.set_initial_extrusion_mode(entry.is_absolute_extrusion(), entry.start_e);
    parser.set_use_layer_markers(index.uses_layer_markers());

    std::istringstream ss(bytes);
    std::string line;
    while (std::getline(ss, line)) {
        parser.parse_line(line);
    }
    auto result = parser.finalize();
    INFO("sub-layers produced: " << result.layers.size());
    // One real layer, plus at most the start of the next one at the chunk edge.
    CHECK(result.layers.size() <= 2);
}

TEST_CASE("#1127 auto-fit never produces NaN from an empty bounding box",
          "[gcode][projection][vase1127]") {
    AABB empty; // default-constructed: min=+inf, max=-inf
    REQUIRE(empty.is_empty());

    for (auto mode : {ViewMode::FRONT, ViewMode::ISOMETRIC, ViewMode::TOP_DOWN}) {
        auto fit = compute_auto_fit(empty, mode, 400, 300);
        INFO("view mode " << static_cast<int>(mode));
        CHECK(std::isfinite(fit.scale));
        CHECK(std::isfinite(fit.offset_x));
        CHECK(std::isfinite(fit.offset_y));
        CHECK(std::isfinite(fit.offset_z));
        CHECK(fit.scale > 0.0f);
    }
}

TEST_CASE("#1127 seeding state costs no extra bytes per layer entry",
          "[gcode][streaming][vase1127]") {
    // The extrusion mode rides in the existing `flags` bitfield and start_e
    // occupies what was tail padding. A big vase print has thousands of these.
    STATIC_REQUIRE(sizeof(StreamingLayerEntry) == 40);
}
