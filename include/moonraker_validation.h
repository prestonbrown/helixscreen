// Copyright (C) 2025-2026 356C LLC
// SPDX-License-Identifier: GPL-3.0-or-later

#pragma once

#include "helix_shared_callback.h"

/**
 * @file moonraker_validation.h
 * @brief Input validators and error-report helpers for the Moonraker sub-APIs
 *
 * Depends only on moonraker_error.h, moonraker_types.h and spdlog, so the
 * ESP32 transport component (which cannot include moonraker_api.h) shares
 * these with the desktop sub-APIs instead of carrying its own copies.
 */

#include "moonraker_error.h"
#include "moonraker_types.h"
#include "spdlog/spdlog.h"
#include "utf8_validation.h"

#include <algorithm>
#include <cctype>
#include <cmath>
#include <cstdint>
#include <functional>
#include <initializer_list>
#include <string>
#include <string_view>

namespace helix {

/**
 * @brief Report a rejected argument exactly once
 *
 * Through @p on_error when the caller passed one (the caller owns how the
 * failure surfaces), otherwise as an error toast. Either way the user sees
 * @p user_message; @p detail only reaches the log.
 * Defined in src/api/moonraker_api_validation.cpp.
 *
 * @param detail Developer-facing reason, logged at warn
 * @param user_message Text a UI shows: the MoonrakerError message or the toast
 */
void report_validation_error(const helix::SharedCallback<void(const MoonrakerError&)>& on_error,
                             const char* method, const std::string& detail,
                             const std::string& user_message);

/**
 * @brief Whether @p cp is a non-ASCII codepoint Python's str.isspace() treats as whitespace
 *
 * Klipper strips and splits G-code lines with Python's Unicode-aware whitespace rules, so
 * any of these inside a parameter value truncates it the way an ASCII space does. U+180E
 * (whitespace only in Unicode tables before 6.3) is included as well.
 */
inline bool is_unicode_space(uint32_t cp) {
    return cp == 0x85 || cp == 0xA0 || cp == 0x1680 || cp == 0x180E ||
           (cp >= 0x2000 && cp <= 0x200A) || cp == 0x2028 || cp == 0x2029 || cp == 0x202F ||
           cp == 0x205F || cp == 0x3000;
}

} // namespace helix

namespace moonraker_internal {

using ErrorCallback = helix::SharedCallback<void(const MoonrakerError&)>;

/**
 * @brief Validate that a string contains only safe identifier characters
 *
 * Allows alphanumeric, underscore, and space (for names like "heater_generic chamber").
 * Rejects newlines, semicolons, and other G-code control characters.
 *
 * @param str String to validate
 * @return true if safe, false otherwise
 */
inline bool is_safe_identifier(const std::string& str) {
    if (str.empty()) {
        return false;
    }

    return std::all_of(str.begin(), str.end(), [](char c) {
        return std::isalnum(static_cast<unsigned char>(c)) || c == '_' || c == ' ';
    });
}

/**
 * @brief Validate a Moonraker file root name.
 *
 * File roots are usually plain identifiers ("gcodes", "config"), but some
 * firmware exposes hidden roots such as ".temp". Keep this narrower than file
 * paths: a leading dot is allowed, but slashes, traversal, control characters,
 * and punctuation such as semicolons remain rejected.
 */
inline bool is_safe_file_root(const std::string& root) {
    if (is_safe_identifier(root)) {
        return true;
    }

    if (root.size() <= 1 || root[0] != '.') {
        return false;
    }

    return is_safe_identifier(root.substr(1));
}

/**
 * @brief Validate that a slicer-emitted object name is safe to pass as a G-code NAME parameter.
 *
 * Object names generated by slicers (OrcaSlicer, PrusaSlicer, SuperSlicer, Cura) routinely
 * contain characters that `is_safe_identifier()` rejects, notably `.`, `-`, `:`, `(`, `)`, `[`, `]`
 * (e.g., `Part.stl_id_0_copy_0`, `model-v2.3mf`, `component:sub`). Rejecting these silently
 * breaks EXCLUDE_OBJECT for most real-world prints (prestonbrown/helixscreen#768).
 *
 * Allows: alphanumeric, `_ - . : ( ) [ ]`, and well-formed UTF-8 for any codepoint from
 * U+00A0 up that is not Unicode whitespace (helix::is_unicode_space()). Rejects everything else —
 * which keeps G-code injection vectors closed: `;` (comment), `\n\r` (line injection), control
 * chars, quotes, backslash, and — critically — whitespace. Klipper's G-code parser tokenizes
 * parameters on whitespace, so a NAME containing a space would either truncate (wrong object
 * excluded) or leak trailing tokens into the parameter list. Slicers URL-encode/underscore-replace
 * spaces in object names, so disallowing space breaks nothing real.
 *
 * Non-ASCII is allowed because slicers keep the model's own name, so a Chinese or Japanese
 * model file defines `EXCLUDE_OBJECT_DEFINE NAME=测试件.stl_id_0_copy_0`, and Klipper accepts
 * it. Every byte of a multi-byte UTF-8 sequence is >= 0x80, so none can be one of the ASCII
 * delimiters above. The sequence must be well-formed because the name travels in a JSON-RPC
 * request, and malformed UTF-8 cannot be serialized.
 */
inline bool is_safe_object_name(const std::string& str) {
    if (str.empty()) {
        return false;
    }

    size_t i = 0;
    while (i < str.size()) {
        const auto c = static_cast<unsigned char>(str[i]);
        if (c < 0x80) {
            if (std::isalnum(c)) {
                ++i;
                continue;
            }
            switch (c) {
            case '_':
            case '-':
            case '.':
            case ':':
            case '(':
            case ')':
            case '[':
            case ']':
                ++i;
                continue;
            default:
                return false;
            }
        }

        const std::optional<helix::text_io::Utf8Sequence> seq = helix::text_io::decode_utf8(str, i);
        // U+0080..U+009F are C1 controls; U+00A0 opens the printable range.
        if (!seq || seq->codepoint < 0xA0 || helix::is_unicode_space(seq->codepoint)) {
            return false;
        }
        i += seq->length;
    }
    return true;
}

/**
 * @brief Validate that a filament material name is safe as a G-code parameter value.
 *
 * Material names carry punctuation that `is_safe_identifier()` rejects. `PLA+`, `PA6-CF`,
 * `PETG-CF`, `PC-ABS`, `Silk PLA` all ship in our own filament database
 * (`include/filament_database.h`), so gating SET_MATERIAL / MMU_GATE_MAP on the identifier
 * charset would make the app offer materials its own persistence layer refuses to send: the
 * save would drop the material, log a warning nobody reads, and report success.
 *
 * Allows: alphanumeric, `+ - _ . ( ) /` and space. Rejects everything else, which keeps the
 * injection vectors closed: `\n\r` (Moonraker runs a `printer.gcode.script` body line by
 * line, so a newline is the one real multi-command vector), `;` and `#` (Klipper's comment
 * characters — they silently truncate the rest of the command), `*` (checksum separator),
 * quote and backslash (both are meaningful to the `shlex` pass described below, so letting
 * them through would let a value escape its own quoting), `=`, control characters, and
 * non-ASCII bytes.
 *
 * Space is allowed because `Silk PLA` and `Matte PLA` are in that same database — but Klipper
 * tokenizes extended-command arguments on whitespace, so callers MUST render the value
 * through `gcode_param_value()` rather than interpolating it raw.
 */
inline bool is_safe_material_param(const std::string& str) {
    if (str.empty()) {
        return false;
    }

    return std::all_of(str.begin(), str.end(), [](char c) {
        auto byte = static_cast<unsigned char>(c);
        if (byte > 0x7F) {
            return false;
        }
        if (std::isalnum(byte)) {
            return true;
        }
        switch (c) {
        case '+':
        case '-':
        case '_':
        case '.':
        case '(':
        case ')':
        case '/':
        case ' ':
            return true;
        default:
            return false;
        }
    });
}

/**
 * @brief Render an already-validated value as a G-code parameter value.
 *
 * Klipper parses the arguments of an extended command (anything not a bare `G`/`M` code —
 * SET_MATERIAL and MMU_GATE_MAP both qualify) with `shlex` in POSIX mode with
 * `whitespace_split`, then splits each token on its first `=`. So `MATERIAL=Silk PLA` arrives
 * as two tokens, the second of which has no `=` at all, and Klipper answers "Malformed
 * command" — the value never reaches the firmware. Quoting it makes shlex yield the one token
 * `MATERIAL=Silk PLA`, with the quotes stripped before the firmware sees it.
 *
 * Only values containing whitespace are quoted, so a value without whitespace goes out on
 * the wire byte-for-byte unchanged.
 *
 * @pre The value has passed a validator that rejects `"` and `\`. Without that this would be
 *      an injection point.
 */
inline std::string gcode_param_value(const std::string& value) {
    if (value.find_first_of(" \t") == std::string::npos) {
        return value;
    }
    return "\"" + value + "\"";
}

/**
 * @brief Validate that a string is safe to percent-encode into a URL query parameter.
 *
 * Moonraker power-device names are arbitrary config section names — `[power -Power-]`,
 * `[power Printer PSU]`, `[power shelly.plug.1]` are all legal — and they routinely contain
 * `-`, `.`, `(`, `)` and other punctuation. Gating `set_device_power()` on
 * `is_safe_identifier()` (alphanumeric, `_`, space only) would reject those names before the
 * request is built, so power control would silently do nothing for any device name with a
 * hyphen (prestonbrown/helixscreen#1241).
 *
 * The caller percent-encodes every non-`[A-Za-z0-9_.-]` byte into the query string and the
 * value never reaches G-code, so no character class needs to be filtered for injection here.
 * The one thing worth rejecting is control characters: they cannot appear in a Moonraker
 * config section name at all, and letting them through would put raw CR/LF into log lines
 * (and into any future caller that forgets to encode).
 *
 * Allows: every non-control byte, including whitespace and multi-byte UTF-8.
 * Rejects: empty strings, and any byte < 0x20 or == 0x7F.
 */
inline bool is_safe_url_param(const std::string& str) {
    if (str.empty()) {
        return false;
    }

    return std::none_of(str.begin(), str.end(), [](char c) {
        auto byte = static_cast<unsigned char>(c);
        return byte < 0x20 || byte == 0x7F;
    });
}

/**
 * @brief Validate that a file path is safe from directory traversal attacks
 *
 * Rejects paths containing:
 * - Parent directory references (..)
 * - Absolute paths (starting with /)
 * - Null bytes (path truncation attack)
 * - Windows-style absolute paths (C:, D:, etc)
 * - Suspicious characters (<>|*?)
 * - Control characters, and the empty path
 *
 * @param path File path to validate
 * @return true if safe relative path, false otherwise
 */
inline bool is_safe_path(const std::string& path) {
    if (path.empty()) {
        return false;
    }

    if (path.find("..") != std::string::npos) {
        return false;
    }

    if (path[0] == '/') {
        return false;
    }

    if (path.find('\0') != std::string::npos) {
        return false;
    }

    if (path.size() >= 2 && path[1] == ':') {
        return false;
    }

    const std::string dangerous_chars = "<>|*?";
    if (path.find_first_of(dangerous_chars) != std::string::npos) {
        return false;
    }

    for (char c : path) {
        if (std::iscntrl(static_cast<unsigned char>(c))) {
            return false;
        }
    }

    return true;
}

/**
 * @brief Validate that an axis character is valid
 *
 * @param axis Axis character to validate
 * @return true if valid axis (X, Y, Z, E), false otherwise
 */
inline bool is_valid_axis(char axis) {
    char upper = static_cast<char>(std::toupper(static_cast<unsigned char>(axis)));
    return upper == 'X' || upper == 'Y' || upper == 'Z' || upper == 'E';
}

/**
 * @brief Validate temperature is in safe range
 *
 * @param temp Temperature in Celsius
 * @param limits Safety limits configuration
 * @return true if within configured range, false otherwise
 */
inline bool is_safe_temperature(double temp, const SafetyLimits& limits) {
    return temp >= limits.min_temperature_celsius && temp <= limits.max_temperature_celsius;
}

/**
 * @brief Validate a target against the ceiling that heater actually declares.
 *
 * Prefer this over the two-argument form wherever the heater is known: the
 * global bound is a 400°C sanity net that no real hotend reaches, so validating
 * against it accepts targets the printer will reject
 * (prestonbrown/helixscreen#1355).
 *
 * @param temp   Target in Celsius
 * @param limits Safety limits configuration
 * @param heater Klipper object name ("extruder", "heater_bed", "chamber")
 */
inline bool is_safe_temperature(double temp, const SafetyLimits& limits,
                                const std::string& heater) {
    return temp >= limits.min_temperature_celsius && temp <= limits.max_temp_for(heater);
}

/**
 * @brief Validate fan speed is in valid percentage range
 *
 * @param speed Speed percentage
 * @param limits Safety limits configuration
 * @return true if within configured range, false otherwise
 */
inline bool is_safe_fan_speed(double speed, const SafetyLimits& limits) {
    return speed >= limits.min_fan_speed_percent && speed <= limits.max_fan_speed_percent;
}

/**
 * @brief Validate feedrate is within safe limits
 *
 * @param feedrate Feedrate in mm/min
 * @param limits Safety limits configuration
 * @return true if within configured range, false otherwise
 */
inline bool is_safe_feedrate(double feedrate, const SafetyLimits& limits) {
    return feedrate >= limits.min_feedrate_mm_min && feedrate <= limits.max_feedrate_mm_min;
}

/**
 * @brief Validate distance is reasonable for axis movement
 *
 * @param distance Distance in mm
 * @param limits Safety limits configuration
 * @return true if within configured range, false otherwise
 */
inline bool is_safe_distance(double distance, const SafetyLimits& limits) {
    return distance >= limits.min_relative_distance_mm &&
           distance <= limits.max_relative_distance_mm;
}

/**
 * @brief Validate position is reasonable for axis positioning
 *
 * @param position Position in mm
 * @param limits Safety limits configuration
 * @return true if within configured range, false otherwise
 */
inline bool is_safe_position(double position, const SafetyLimits& limits) {
    return position >= limits.min_absolute_position_mm &&
           position <= limits.max_absolute_position_mm;
}

// ============================================================================
// VALIDATION + ERROR HELPERS
// ============================================================================
// These functions combine validation with error callback invocation, reducing
// the ~10-line boilerplate pattern repeated in every API method.
//
// Usage:
//   if (reject_invalid_path(filename, "method_name", on_error)) return;
//   if (reject_invalid_path(filename, "method_name", on_error, silent)) return;

/**
 * @brief Validate path and invoke error callback if invalid
 *
 * Consolidates the common pattern of:
 * 1. Check is_safe_path()
 * 2. Log at error level if !silent
 * 3. Construct MoonrakerError and call on_error if provided
 *
 * @param path Path to validate
 * @param method Method name for error context
 * @param on_error Error callback (may be nullptr)
 * @param silent If true, skip error logging (default: false)
 * @return true if path is INVALID (caller should return), false if valid
 */
inline bool reject_invalid_path(const std::string& path, const char* method,
                                const ErrorCallback& on_error, bool silent = false) {
    if (is_safe_path(path)) {
        return false; // Valid, continue
    }

    if (!silent) {
        spdlog::error("[Moonraker API] {}: Invalid path '{}'", method, path);
    }

    if (on_error) {
        MoonrakerError err = MoonrakerError::validation_error(
            method, "Invalid path contains directory traversal or illegal characters");
        on_error(err);
    }
    return true; // Invalid, caller should return
}

/**
 * @brief Validate identifier and invoke error callback if invalid
 *
 * For validating root names, heater names, etc.
 *
 * @param id Identifier to validate
 * @param method Method name for error context
 * @param on_error Error callback (may be nullptr)
 * @param silent If true, skip error logging (default: false)
 * @return true if identifier is INVALID (caller should return), false if valid
 */
inline bool reject_invalid_identifier(const std::string& id, const char* method,
                                      const ErrorCallback& on_error, bool silent = false) {
    if (is_safe_identifier(id)) {
        return false; // Valid, continue
    }

    if (!silent) {
        spdlog::error("[Moonraker API] {}: Invalid identifier '{}'", method, id);
    }

    if (on_error) {
        MoonrakerError err = MoonrakerError::validation_error(
            method, "Invalid identifier contains illegal characters");
        on_error(err);
    }
    return true; // Invalid, caller should return
}

/**
 * @brief Validate Moonraker file root and invoke error callback if invalid.
 */
inline bool reject_invalid_file_root(const std::string& root, const char* method,
                                     const ErrorCallback& on_error, bool silent = false) {
    if (is_safe_file_root(root)) {
        return false; // Valid, continue
    }

    if (!silent) {
        spdlog::error("[Moonraker API] {}: Invalid file root '{}'", method, root);
    }

    if (on_error) {
        MoonrakerError err = MoonrakerError::validation_error(
            method, "Invalid file root contains illegal characters");
        on_error(err);
    }
    return true; // Invalid, caller should return
}

/**
 * @brief Check if value is in range and invoke error callback if not
 *
 * For validating temperatures, speeds, positions, etc.
 *
 * @param value Value to check
 * @param min Minimum allowed value
 * @param max Maximum allowed value
 * @param param_name Parameter name for error message (e.g., "temperature")
 * @param method Method name for error context
 * @param on_error Error callback (may be nullptr)
 * @param silent If true, skip error logging (default: false)
 * @return true if value is OUT OF RANGE (caller should return), false if valid
 */
inline bool reject_out_of_range(double value, double min, double max, const char* param_name,
                                const char* method, const ErrorCallback& on_error,
                                bool silent = false) {
    if (value >= min && value <= max) {
        return false; // Valid, continue
    }

    if (!silent) {
        spdlog::error("[Moonraker API] {}: {} {} out of range [{}, {}]", method, param_name, value,
                      min, max);
    }

    if (on_error) {
        MoonrakerError err = MoonrakerError::validation_error(
            method, std::string(param_name) + " value out of allowed range");
        on_error(err);
    }
    return true; // Invalid, caller should return
}

/**
 * @brief Check if any double value is NaN or Inf, and reject with error callback if so
 *
 * Prevents malformed G-code from being sent to the printer when upstream data
 * contains NaN or Inf values (e.g., from corrupted JSON or division by zero).
 *
 * @param values List of double values to check
 * @param method Method name for error context
 * @param on_error Error callback (may be nullptr)
 * @return true if any value is NON-FINITE (caller should return), false if all valid
 */
inline bool reject_non_finite(std::initializer_list<double> values, const char* method,
                              const ErrorCallback& on_error) {
    for (double v : values) {
        if (std::isnan(v) || std::isinf(v)) {
            spdlog::warn("[Moonraker API] {}: Rejecting G-code generation: "
                         "invalid value (NaN/Inf)",
                         method);
            if (on_error) {
                MoonrakerError err =
                    MoonrakerError::validation_error(method, "Parameter contains NaN or Inf value");
                on_error(err);
            }
            return true; // Invalid, caller should return
        }
    }
    return false; // All finite, continue
}

// ============================================================================
// ERROR REPORTING HELPERS
// ============================================================================
// These functions consolidate the common pattern of:
// 1. Check if callback exists
// 2. Construct MoonrakerError with appropriate type
// 3. Invoke callback
//
// Usage:
//   report_error(on_error, MoonrakerErrorType::CONNECTION_LOST, "method", "message");
//   report_http_error(on_error, 404, "method", "status message");

using helix::report_validation_error;

/**
 * @brief Report an error via callback with specified type
 *
 * @param on_error Error callback (may be nullptr)
 * @param type Error type classification
 * @param method Method name for error context
 * @param message Human-readable error message
 * @param code Optional error code (default: 0)
 */
inline void report_error(const ErrorCallback& on_error, MoonrakerErrorType type,
                         std::string_view method, std::string_view message, int code = 0) {
    if (!on_error)
        return;

    MoonrakerError err;
    err.type = type;
    err.method = std::string(method);
    err.message = std::string(message);
    err.code = code;
    on_error(err);
}

} // namespace moonraker_internal
